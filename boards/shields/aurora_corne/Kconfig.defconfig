## boards/shields/aurora_corne/Kconfig.defconfig
```kconfig
# Aurora Corne keyboard default configuration

if SHIELD_AURORA_CORNE_LEFT

config ZMK_KEYBOARD_NAME
    default "Aurora Corne"

config ZMK_SPLIT_ROLE_CENTRAL
    default y

endif

if SHIELD_AURORA_CORNE_LEFT || SHIELD_AURORA_CORNE_RIGHT

config ZMK_SPLIT
    default y

endif
```
